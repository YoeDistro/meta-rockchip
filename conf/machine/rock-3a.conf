## conf/machine/rock-3a.conf
```bitbake
#@TYPE: Machine
#@NAME: Radxa Rock 3a
#@DESCRIPTION: ROCK3 is a series of Rockchip RK3566/RK3568 based SBC(Single Board Computer) and Compute Module by Radxa.
#https://wiki.radxa.com/Rock3/3a

require conf/machine/include/rk3568.inc

KERNEL_DEVICETREE = "rockchip/rk3568-rock-3a.dtb"
MACHINE_EXTRA_RRECOMMENDS += "kernel-modules"

UBOOT_MACHINE = "rock-3a-rk3568_defconfig"
```

## conf/machine/rock-4c-plus.conf
```bitbake
#@TYPE: Machine
#@NAME: ROCK 4C Plus
#@DESCRIPTION: ROCK 4C Plus based on Rockchip RK3399-T Processor is designed by Radxa.
#https://wiki.radxa.com/Rock4/4cplus
#https://docs.radxa.com/en/rock4/rock4c+

require conf/machine/include/rock-pi-4.inc

KERNEL_DEVICETREE = "rockchip/rk3399-rock-4c-plus.dtb"
UBOOT_MACHINE = "rock-4c-plus-rk3399_defconfig"
```

## conf/machine/rock-5a.conf
```bitbake
#@TYPE: Machine
#@NAME: Radxa Rock 5A
#@DESCRIPTION: ROCK5 is the 5th generation of SBC designed by Radxa.
#https://docs.radxa.com/en/rock5/rock5a

require conf/machine/include/rk3588s.inc

KERNEL_DEVICETREE = "rockchip/rk3588s-rock-5a.dtb"
MACHINE_EXTRA_RRECOMMENDS += "kernel-modules"

UBOOT_MACHINE = "rock5a-rk3588s_defconfig"
```

## conf/machine/rock-pi-4b-plus.conf
```bitbake
#@TYPE: Machine
#@NAME: Radxa Rock 4B+ OP1
#@DESCRIPTION: An OP1 SBC with Wi-Fi 5 & BT 5 and PoE Support.
#https://docs.radxa.com/en/rock4/rock4ab-se

require conf/machine/include/rock-pi-4.inc

KERNEL_DEVICETREE = "rockchip/rk3399-rock-pi-4b-plus.dtb"
UBOOT_MACHINE = "rock-pi-4-rk3399_defconfig"
```

## conf/machine/rock-pi-e.conf
```bitbake
#@TYPE: Machine
#@NAME: ROCK Pi E rk3328
#@DESCRIPTION: ROCK Pi E is a Rockchip RK3328-based SBC by Radxa. E is for Ethernets.
#https://wiki.radxa.com/RockpiE

require conf/machine/include/rk3328.inc

KERNEL_DEVICETREE = "rockchip/rk3328-rock-pi-e.dtb"
MACHINE_EXTRA_RRECOMMENDS += "kernel-modules"

UBOOT_MACHINE = "rock-pi-e-rk3328_defconfig"
```

## conf/machine/rock-pi-s.conf
```bitbake
#@TYPE: Machine
#@NAME: Radxa Rock Pi S
#@DESCRIPTION: ROCK Pi S is a Rockchip RK3308 based SBC by Radxa. "S" stands for "small square"
#https://wiki.radxa.com/RockpiS

require conf/machine/include/rk3308.inc

KERNEL_DEVICETREE = "rockchip/rk3308-rock-pi-s.dtb"
MACHINE_EXTRA_RRECOMMENDS += "kernel-modules"

UBOOT_MACHINE = "rock-pi-s-rk3308_defconfig"
```

## conf/machine/soquartz-model-a.conf
```bitbake
#Copyright (C) Trifork A/S 2024
# Released under the MIT license (see COPYING.MIT for the terms)

#@TYPE: Machine
#@NAME: SOQuartz on Model A base board
#@DESCRIPTION: SOQuartz is a series of Compute Module by Pine64, the Model A baseboard provides standard connectors for the compute module
#https://wiki.pine64.org/wiki/SOQuartz#SOQuartz_Model-A_Baseboard_Features

require conf/machine/include/soquartz.inc

KERNEL_DEVICETREE = "rockchip/rk3566-soquartz-model-a.dtb"
UBOOT_MACHINE = "soquartz-model-a-rk3566_defconfig"
```

## conf/machine/tinker-board-s.conf
```bitbake
# Copyright (C) 2020  Sergey Bostandzhyan
# Released under the MIT license (see COPYING.MIT for the terms)

#@TYPE: Machine
#@NAME: Tinker-S RK3288
#@DESCRIPTION: ASUS Tinker Board is a Raspberry Pi 3 Alternative based on Rockchip RK3288 Processor.

require conf/machine/include/tinker.inc

KERNEL_DEVICETREE = "rockchip/rk3288-tinker-s.dtb"
UBOOT_MACHINE = "tinker-s-rk3288_defconfig"
```

## conf/machine/tinker-board.conf
```bitbake
# Copyright (C) 2018  Trevor Woerner
# Released under the MIT license (see COPYING.MIT for the terms)

#@TYPE: Machine
#@NAME: Tinker RK3288
#@DESCRIPTION: ASUS Tinker Board is a Raspberry Pi 3 Alternative based on Rockchip RK3288 Processor.

require conf/machine/include/tinker.inc

KERNEL_DEVICETREE = "rockchip/rk3288-tinker.dtb"
UBOOT_MACHINE = "tinker-rk3288_defconfig"
```

## conf/machine/vyasa-rk3288.conf
```bitbake
# Copyright (C) 2018 Amarula Solutions
# Released under the MIT license (see COPYING.MIT for the terms)

#@TYPE: Machine
#@NAME: Amarula Vyasa RK3288
#@DESCRIPTION: Amarula Vyasa is Rockchip RK3288 SOC based Single board computer with fully supported opensource software.

require conf/machine/include/rk3288.inc
require conf/machine/include/rockchip-wic.inc

KERNEL_IMAGETYPE = "uImage"
KERNEL_DEVICETREE = "rockchip/rk3288-vyasa.dtb"
KERNEL_EXTRA_ARGS += "LOADADDR=0x02000000"

UBOOT_MACHINE = "vyasa-rk3288_defconfig"
```

## wic/rockchip.wks
```
# Copyright (C) 2019,2020 Garmin Ltd. or its subsidiaries
# Copyright (C) 2021 Trevor Woerner
# Released under the MIT license (see COPYING.MIT for the terms)
#
# short-description: Create a disk image suitable for booting Rockchip from SD-card
# long-description: Creates a disk image partitioned using GPT, suitable for Rockchip
# Disk layout
# See: https://opensource.rock-chips.com/wiki_Partitions
#
#   Partition   Start Sector    Number of Sectors
#   loader1     64              8000        (idbloader / U-Boot SPL)
#   reserved1   8064            128
#   reserved2   8192            8192
#   loader2     16384           8192        (U-Boot proper)
#   atf         24576           8192
#   boot        32768           229376
#   root        262144          -           (suggested)

part loader1    --offset 64s    --fixed-size 4000K   --fstype=none            --source rawcopy                                   --sourceparams="file=${SPL_BINARY}"
part reserved1  --offset 8064s  --fixed-size 64K     --fstype=none
part reserved2  --offset 8192s  --fixed-size 4096K   --fstype=none
part loader2    --offset 16384s --fixed-size 4096K   --fstype=none            --source rawcopy                                   --sourceparams="file=u-boot.${UBOOT_SUFFIX}"
part atf        --offset 24576s --fixed-size 4096K   --fstype=none
part /boot      --offset 32768s --size       114688K --fstype=vfat --active   --source bootimg-partition --label boot --use-uuid --sourceparams="loader=u-boot"
part /                                               --fstype=ext4            --source rootfs            --label root --use-uuid

bootloader --ptable gpt --append="console=tty1 console=${RK_CONSOLE_DEVICE},${RK_CONSOLE_BAUD}n8 rw rootfstype=ext4 init=/sbin/init"
```
