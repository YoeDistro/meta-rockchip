## conf/layer.conf
```bitbake
# Copyright (C) 2014 NEO-Technologies
# Released under the MIT license (see COPYING.MIT for the terms)

# We have a conf and classes directory, add to BBPATH
BBPATH .= ":${LAYERDIR}"

# We have recipes-* directories, add to BBFILES
BBFILES += "${LAYERDIR}/recipes-*/*/*.bb ${LAYERDIR}/recipes-*/*/*.bbappend"

BBFILE_COLLECTIONS += "rockchip"
BBFILE_PATTERN_rockchip = "^${LAYERDIR}/"
BBFILE_PRIORITY_rockchip = "1"

# This should only be incremented on significant changes that will
# cause compatibility issues with other layers
LAYERVERSION_rockchip = "1"
LAYERSERIES_COMPAT_rockchip = "styhead"
LAYERDEPENDS_rockchip = "core meta-arm"

BBFILES_DYNAMIC += " \
    qt5-layer:${LAYERDIR}/dynamic-layers/qt5-layer/*/*/*.bb \
    qt5-layer:${LAYERDIR}/dynamic-layers/qt5-layer/*/*/*.bbappend \
"
BBFILES_DYNAMIC += " \
    rauc:${LAYERDIR}/dynamic-layers/rk-rauc-demo/*/*/*.bb \
    rauc:${LAYERDIR}/dynamic-layers/rk-rauc-demo/*/*/*.bbappend \
"
```

## conf/machine/include/radxa-zero-3.inc
```bitbake
MACHINEOVERRIDES =. "radxa-zero-3:"

require conf/machine/include/rk3566.inc

MACHINE_EXTRA_RRECOMMENDS += "kernel-modules"

UBOOT_MACHINE = "radxa-zero-3-rk3566_defconfig"
```

## conf/machine/include/rk3066.inc
```bitbake
# Copyright (C) 2014 NEO-Technologies
# Released under the MIT license (see COPYING.MIT for the terms)

DEFAULTTUNE = "cortexa9-neon"
require conf/machine/include/tune-cortexa9.inc

PREFERRED_PROVIDER_virtual/xserver = "xserver-xorg"

XSERVER = "xserver-xorg \
           xf86-video-fbturbo \
           xf86-input-evdev \
           xf86-input-mouse \
           xf86-input-keyboard"

PREFERRED_PROVIDER_virtual/kernel = "linux-rockchip"

KERNEL_IMAGETYPE = "zImage"

IMAGE_FSTYPES += "ext4"

SERIAL_CONSOLES ?= "115200;ttyFIQ0"
KBUILD_DEFCONFIG = "multi_v7_defconfig"
```

## conf/machine/include/rk3188.inc
```bitbake
# Copyright (C) 2015 Romain Perier
# Released under the MIT license (see COPYING.MIT for the terms)

SOC_FAMILY  = "rk3188"
RK_KERNEL_FITIMAGE ?= "False"

require conf/machine/include/soc-family.inc
require conf/machine/include/rockchip-defaults.inc
require conf/machine/include/arm/armv7a/tune-cortexa9.inc

SERIAL_CONSOLES = "115200;ttyFIQ0"

KBUILD_DEFCONFIG = "multi_v7_defconfig"

ENABLE_STATELESS_VPU_GST ?= "1"
```

## conf/machine/include/rk3288.inc
```bitbake
# Copyright (C) 2015 Romain Perier
# Released under the MIT license (see COPYING.MIT for the terms)

SOC_FAMILY = "rk3288"
RK_KERNEL_FITIMAGE ?= "False"

require conf/machine/include/soc-family.inc
require conf/machine/include/rockchip-defaults.inc
require conf/machine/include/arm/armv7a/tune-cortexa17.inc

SERIAL_CONSOLES = "115200;ttyS2"

KBUILD_DEFCONFIG ?= "multi_v7_defconfig"

# Set UBOOT_SUFFIX to "itb" if you are going to use OP-TEE
UBOOT_SUFFIX ?= "img"

ENABLE_STATELESS_VPU_GST ?= "1"
```

## conf/machine/include/rk3308.inc
```bitbake
SOC_FAMILY = "rk3308"

DEFAULTTUNE ?= "cortexa35-crypto"

ROCKCHIP_CLOSED_TPL ?= "1"

require conf/machine/include/soc-family.inc
require conf/machine/include/rockchip-defaults.inc
require conf/machine/include/arm/armv8a/tune-cortexa35.inc
require conf/machine/include/rockchip-wic.inc

SERIAL_CONSOLES = "1500000;ttyS0"

KBUILD_DEFCONFIG ?= "defconfig"

UBOOT_SUFFIX ?= "itb"
UBOOT_ENTRYPOINT ?= "0x06000000"

PREFERRED_PROVIDER_trusted-firmware-a = "${@bb.utils.contains('RKBIN_RK3308_LATEST', '1', 'rockchip-rkbin-tf-a', 'rk3308-rkbin', d)}"
PREFERRED_PROVIDER_rockchip-rkbin-ddr = "${@bb.utils.contains('RKBIN_RK3308_LATEST', '1', 'rockchip-rkbin-ddr', 'rk3308-rkbin', d)}"
PREFERRED_PROVIDER_rockchip-rkbin-tf-a = "${@bb.utils.contains('RKBIN_RK3308_LATEST', '1', 'rockchip-rkbin-tf-a', 'rk3308-rkbin', d)}"
PREFERRED_PROVIDER_rockchip-rkbin-optee-os = "${@bb.utils.contains('RKBIN_RK3308_LATEST', '1', 'rockchip-rkbin-optee-os', 'rk3308-rkbin', d)}"
```

## conf/machine/include/rk3399.inc
```bitbake
# Copyright (C) 2020 Garmin Ltd. or its subsidaries
# Released under the MIT license (see COPYING.MIT for the terms)

SOC_FAMILY = "rk3399"

DEFAULTTUNE ?= "cortexa72-cortexa53-crypto"

require conf/machine/include/soc-family.inc
require conf/machine/include/rockchip-defaults.inc
require conf/machine/include/arm/armv8a/tune-cortexa72-cortexa53.inc
require conf/machine/include/rockchip-wic.inc

KBUILD_DEFCONFIG ?= "defconfig"

TFA_PLATFORM = "rk3399"
TFA_BUILD_TARGET = "bl31"

UBOOT_SUFFIX ?= "itb"
UBOOT_ENTRYPOINT ?= "0x06000000"

ENABLE_STATELESS_VPU_GST ?= "1"
```

## conf/machine/include/rk3568.inc
```bitbake
SOC_FAMILY = "rk3568"

DEFAULTTUNE ?= "cortexa55"

ROCKCHIP_CLOSED_TPL ?= "1"

require conf/machine/include/soc-family.inc
require conf/machine/include/rockchip-defaults.inc
require conf/machine/include/arm/armv8-2a/tune-cortexa55.inc
require conf/machine/include/rockchip-wic.inc

KBUILD_DEFCONFIG ?= "defconfig"
KERNEL_FEATURES:append:rk3568 = " bsp/rockchip/remove-non-rockchip-arch-arm64.scc"
KERNEL_CLASSES = "kernel-fitimage"
KERNEL_IMAGETYPE ?= "fitImage"

PREFERRED_PROVIDER_trusted-firmware-a = "rockchip-rkbin-tf-a"
PREFERRED_PROVIDER_optee-os = "rockchip-rkbin-optee-os"

UBOOT_SUFFIX ?= "itb"
UBOOT_ENTRYPOINT ?= "0x06000000"

TFA_PLATFORM = "rk3568"
TFA_BUILD_TARGET = "bl31"

ENABLE_STATELESS_VPU_GST ?= "1"
```

## conf/machine/include/rk3588s.inc
```bitbake
SOC_FAMILY ?= "rk3588s"
MACHINEOVERRIDES =. "rk3588s:"
DEFAULTTUNE ?= "cortexa76-cortexa55-crypto"

ROCKCHIP_CLOSED_TPL ?= "1"

require conf/machine/include/rockchip-defaults.inc
require conf/machine/include/arm/armv8-2a/tune-cortexa76-cortexa55.inc
require conf/machine/include/rockchip-wic.inc

KBUILD_DEFCONFIG ?= "defconfig"

PREFERRED_PROVIDER_trusted-firmware-a = "rockchip-rkbin-tf-a"
PREFERRED_PROVIDER_optee-os = "rockchip-rkbin-optee-os"

UBOOT_SUFFIX ?= "itb"
UBOOT_ENTRYPOINT ?= "0x06000000"

TFA_PLATFORM = "rk3588"
TFA_BUILD_TARGET = "bl31"

ENABLE_STATELESS_VPU_GST ?= "1"
```

## conf/machine/include/rockchip-defaults.inc
```bitbake
# meta-rockchip default settings
MACHINEOVERRIDES =. "${@bb.utils.contains('ROCKCHIP_CLOSED_TPL', '1', 'closed-tpl:', '', d)}"
MACHINEOVERRIDES =. "rockchip:"

# kernel
# RK_KERNEL_FITIMAGE needs to be set before the next "require ..."
RK_KERNEL_FITIMAGE ?= "True"
PREFERRED_PROVIDER_virtual/kernel ?= "linux-yocto"
KCONFIG_MODE ?= "alldefconfig"
MACHINE_ESSENTIAL_EXTRA_RDEPENDS_KERNEL = "kernel-devicetree"
MACHINE_ESSENTIAL_EXTRA_RDEPENDS += "${MACHINE_ESSENTIAL_EXTRA_RDEPENDS_KERNEL}"
require ${@ 'conf/machine/include/rockchip-fitimage.inc' if bb.utils.to_boolean(d.getVar('RK_KERNEL_FITIMAGE')) else ''}
KERNEL_IMAGETYPE ?= "zImage"

# xserver
XSERVER = " \
	xserver-xorg \
	xserver-xorg-utils \
	xserver-xorg-xvfb \
	xserver-xorg-extension-glx \
	xserver-xorg-module-libwfb \
	xserver-xorg-module-exa \
	xf86-video-modesetting \
	xf86-input-evdev \
	"

# misc
SERIAL_CONSOLES ?= "1500000;ttyS2"
RK_CONSOLE_BAUD ?= "${@d.getVar('SERIAL_CONSOLES').split(';')[0]}"
RK_CONSOLE_DEVICE ?= "${@d.getVar('SERIAL_CONSOLES').split(';')[1].split()[0]}"

# Discoverable Partitions Specification (DPS)
ROOT_DPS:arm = "69dad710-2ce4-4e3c-b16c-21a1d49abed3"
ROOT_DPS:aarch64 = "b921b045-1df0-41c3-af44-4c6f280d3fae"
```

## conf/machine/include/rockchip-extlinux.inc
```bitbake
# KERNEL_DEVICETREE follows the pattern of
# 'rockchip/${SOC_FAMILY}-${BOARD}.dtb' which is required when compiling
# the kernel so the kernel's Makefile can find the device tree
#
# when using extlinux with a fitImage the device tree is contained in the
# fitImage
#
# however for non-fitImages it is not found at
# $UBOOT_EXTLINUX_FDTDIR/rockchip/$KERNEL_DEVICETREE but rather at
# $UBOOT_EXTLINUX_FDTDIR/$KERNEL_DEVICETREE therefore we need to strip off
# the 'rockchip/' part for extlinux non-fitImage builds
NONFITDT ?= "${@d.getVar('KERNEL_DEVICETREE').split()[0].split('/')[1]}"

UBOOT_EXTLINUX ?= "1"
UBOOT_EXTLINUX_ROOT ?= "root=PARTLABEL=rootfsA"
UBOOT_EXTLINUX_FDTDIR ?= "${@ '' if bb.utils.to_boolean(d.getVar('RK_KERNEL_FITIMAGE')) else '/boot'}"
UBOOT_EXTLINUX_FDT ?= "${@ '' if bb.utils.to_boolean(d.getVar('RK_KERNEL_FITIMAGE')) else '/boot/${NONFITDT}'}"
UBOOT_EXTLINUX_CONSOLE ?= "earlycon console=tty1 console=${RK_CONSOLE_DEVICE},${RK_CONSOLE_BAUD}n8"
UBOOT_EXTLINUX_KERNEL_ARGS ?= "rootwait rw rootfstype=ext4"
UBOOT_EXTLINUX_KERNEL_IMAGE ?= "/boot/${@ 'fitImage' if bb.utils.to_boolean(d.getVar('RK_KERNEL_FITIMAGE')) else '${KERNEL_IMAGETYPE}'}"
UBOOT_EXTLINUX_LABELS ?= "default"
UBOOT_EXTLINUX_MENU_DESCRIPTION:default ?= "${MACHINE}"

MACHINE_ESSENTIAL_EXTRA_RDEPENDS += "u-boot-extlinux"
```

## conf/machine/include/rockchip-fitimage.inc
```bitbake
KERNEL_CLASSES += "kernel-fit-extra-artifacts"
KERNEL_IMAGETYPE ?= "Image"
RRECOMMENDS:${KERNEL_PACKAGE_NAME}-base = ""
KERNEL_DEPLOY_DEPEND ?= "linux-yocto-fitimage:do_deploy"
MACHINE_ESSENTIAL_EXTRA_RDEPENDS_KERNEL = "linux-yocto-fitimage"
```

## conf/machine/include/rockchip-rauc.inc
```bitbake
# 'RK_RAUC_DEMO' indicates the user wants to use the
# rauc demo configuration from this layer
OVERRIDES .= "${@ ':rk-rauc-demo' if bb.utils.to_boolean(d.getVar('RK_RAUC_DEMO'), False) else ''}"
IMAGE_INSTALL:append:rk-rauc-demo = " abd-partition"
IMAGE_INSTALL:append:rk-rauc-demo = " ${@ 'data-partition-overlay' if bb.utils.to_boolean(d.getVar('RK_OVERLAY_DEMO'), False) else ''}"
```

## conf/machine/include/rockchip-rk-u-boot-env.inc
```bitbake
# 'rk-u-boot-env' indicates the user wants to be able to save their U-Boot
# environment back to the drive from which the device was booted
MACHINEOVERRIDES .= "${@bb.utils.contains('MACHINE_FEATURES', 'rk-u-boot-env', ':rk-u-boot-env', '', d)}"
IMAGE_INSTALL:append:rk-u-boot-env = " u-boot-fw-utils u-boot-env"
```

## conf/machine/include/rockchip-wic.inc
```bitbake
# common meta-rockchip wic/wks items

require conf/machine/include/rockchip-extlinux.inc
require conf/machine/include/rockchip-rk-u-boot-env.inc

SPL_BINARY ?= "idbloader.img"

IMAGE_FSTYPES += "wic wic.bmap"
WKS_FILE ?= "rockchip.wks"
WKS_FILE_DEPENDS ?= " \
	e2fsprogs-native \
	virtual/bootloader \
	"

RK_IMAGE_INCLUDES_UBOOT_ENV ?= "no"
RK_UBOOT_ENV = " "
RK_UBOOT_ENV:rk-u-boot-env = "${@ '--source rawcopy --sourceparams=file=u-boot.env' \
	if bb.utils.to_boolean(d.getVar('RK_IMAGE_INCLUDES_UBOOT_ENV'), False) else ' '}"

WICVARS:append = " \
	RK_UBOOT_ENV \
	SPL_BINARY \
	UBOOT_SUFFIX \
	"
```

## conf/machine/include/soquartz.inc
```bitbake
#Copyright (C) Trifork A/S 2024
# Released under the MIT license (see COPYING.MIT for the terms)

# Common override for basing a SOQuartz design on
# https://wiki.pine64.org/wiki/SOQuartz

MACHINEOVERRIDES =. "soquartz:"

require conf/machine/include/rk3566.inc

# A machine using this baseboard could use these options or overload them
# UBOOT_MACHINE ?= "soquartz-cm4-rk3566_defconfig"
# KERNEL_DEVICETREE ?= "rockchip/rk3566-soquartz-cm4.dtb"

MACHINE_EXTRA_RRECOMMENDS += "kernel-modules"
```

## conf/machine/nanopc-t6.conf
```bitbake
#@TYPE: Machine
#@NAME: NanoPC-T6
#@DESCRIPTION: NanoPC-T6 from FriendlyElec
#https://www.friendlyelec.com/index.php?route=product/product&path=69&product_id=292

require conf/machine/include/rk3588.inc

PREFERRED_PROVIDER_virtual/kernel = "linux-yocto-dev"
KERNEL_DEVICETREE = " \
    rockchip/rk3588-nanopc-t6.dtb \
    rockchip/rk3588-nanopc-t6-lts.dtb \
"
MACHINE_EXTRA_RRECOMMENDS += "kernel-modules"

UBOOT_MACHINE = "nanopc-t6-rk3588_defconfig"
```

## conf/machine/nanopi-m4b.conf
```bitbake
#@TYPE: Machine
#@NAME: NanoPi M4B
#@DESCRIPTION: NanoPi M4B RK3399-based board which has the same form factor as the RPi B3+.
#https://www.friendlyelec.com/index.php?route=product/product&product_id=275

require conf/machine/include/rk3399.inc

MACHINE_EXTRA_RRECOMMENDS += "kernel-modules"

KERNEL_DEVICETREE = "rockchip/rk3399-nanopi-m4b.dtb"
UBOOT_MACHINE = "nanopi-m4b-rk3399_defconfig"
```

## conf/machine/nanopi-r2s.conf
```bitbake
#@TYPE: Machine
#@NAME: NanoPi R2S
#@DESCRIPTION: The NanoPi R2S is a mini router with edge computing and dual GbE ports by FriendlyElec
#https://www.friendlyelec.com/index.php?route=product/product&product_id=282

require conf/machine/include/rk3328.inc

KERNEL_DEVICETREE = "rockchip/rk3328-nanopi-r2s.dtb"
MACHINE_EXTRA_RRECOMMENDS += "kernel-modules"

UBOOT_MACHINE = "nanopi-r2s-rk3328_defconfig"
```

## conf/machine/nanopi-r4s.conf
```bitbake
#@TYPE: Machine
#@NAME: NanoPi R4S
#@DESCRIPTION: NanoPi R4S is a high-end FriendlyElec mini-router based on the RK3399 SoC
#https://www.friendlyelec.com/index.php?route=product/product&product_id=284

require conf/machine/include/rk3399.inc

MACHINE_EXTRA_RRECOMMENDS += "kernel-modules"

KERNEL_DEVICETREE = "rockchip/rk3399-nanopi-r4s.dtb"
UBOOT_MACHINE = "nanopi-r4s-rk3399_defconfig"
```

## conf/machine/orangepi-3b.conf
```bitbake
#@TYPE: Machine
#@NAME: Orange Pi 3B
#@DESCRIPTION: Raspberry Pi sized SBC designed by Kunlong Co.,Limited.
#http://www.orangepi.org/html/hardWare/computerAndMicrocontrollers/details/Orange-Pi-3B.html

require conf/machine/include/rk3566.inc

KERNEL_DEVICETREE = "rockchip/rk3566-orangepi-3b-v2.1.dtb rockchip/rk3566-orangepi-3b-v1.1.dtb"
MACHINE_EXTRA_RRECOMMENDS += "kernel-modules"

UBOOT_MACHINE = "orangepi-3b-rk3566_defconfig"
```

## conf/machine/radxa-zero-3e.conf
```bitbake
#@TYPE: Machine
#@NAME: Radxa Zero 3E
#@DESCRIPTION: The Radxa ZERO 3e is an ultra-small, high-performance single board computer based on the Rockchip RK3566, with a compact form factor, and rich interfaces.
#http://radxa.com/products/zeros/zero3e/

require conf/machine/include/rk3566.inc

PREFERRED_PROVIDER_virtual/kernel = "linux-torvalds-next"
KERNEL_DEVICETREE = "rockchip/rk3566-radxa-zero-3e.dtb"
MACHINE_EXTRA_RRECOMMENDS += "kernel-modules"

UBOOT_MACHINE = "radxa-zero-3-rk3566_defconfig"
```

## conf/machine/radxa-zero-3w.conf
```bitbake
#@TYPE: Machine
#@NAME: Radxa Zero 3W
#@DESCRIPTION: The Radxa ZERO 3w is an ultra-small, high-performance single board computer based on the Rockchip RK3566, with a compact form factor, and rich interfaces.
#http://radxa.com/products/zeros/zero3w/

require conf/machine/include/radxa-zero-3.inc
KERNEL_DEVICETREE = "rockchip/rk3566-radxa-zero-3w.dtb"
```

## conf/machine/roc-rk3308-cc.conf
```bitbake
# Copyright (C) 2024  Trevor Woerner
# Released under the MIT license (see COPYING.MIT for the terms)

#@TYPE: Machine
#@NAME: roc-rk3308-cc
#@DESCRIPTION: T-Firefly ROC-RK3308-CC SBC
#https://en.t-firefly.com/product/rocrk3308cc

require include/rk3308.inc

UBOOT_MACHINE = "roc-cc-rk3308_defconfig"
KERNEL_DEVICETREE = "rockchip/rk3308-roc-cc.dtb"
```

## conf/machine/roc-rk3328-cc.conf
```bitbake
# Copyright (C) 2021  Trevor Woerner
# Released under the MIT license (see COPYING.MIT for the terms)

#@TYPE: Machine
#@NAME: roc-rk3328-cc (aka "renegade")
#@DESCRIPTION: Libre Computer Board ROC-RK3328-CC (Renegade) Mini Computer with Gigabit Ethernet and USB 3.0

require include/rk3328.inc

UBOOT_MACHINE = "roc-cc-rk3328_defconfig"
KERNEL_DEVICETREE = "rockchip/rk3328-roc-cc.dtb"
```
